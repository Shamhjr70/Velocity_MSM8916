## arch/arm64/hotplug/Kconfig
```kconfig
config ASMP
 	bool "Multi-core automatic hotplug support"
 	depends on SMP
 	default n
 	help
   	  Automatically hotplugs the multiple cpu cores on and off based on cpu load and suspend state

config BRICKED_HOTPLUG
	 bool "Enable kernel based mpdecision"
	 depends on MSM_RUN_QUEUE_STATS
	 default y
	 help
           This enables kernel based multi core control.

config ALUCARD_HOTPLUG
	bool "Enable alucard-hotplug cpu hotplug driver"
 	default n
 	help
 	  Generic Alucard-hotplug cpu hotplug driver for ARM SOCs
```
